/* Copyright (c) 2013, The Linux Foundation. All rights reserved.
 *
 * This program is free software; you can redistribute it and/or modify
 * it under the terms of the GNU General Public License version 2 and
 * only version 2 as published by the Free Software Foundation.
 *
 * This program is distributed in the hope that it will be useful,
 * but WITHOUT ANY WARRANTY; without even the implied warranty of
 * MERCHANTABILITY or FITNESS FOR A PARTICULAR PURPOSE.  See the
 * GNU General Public License for more details.
 */

/*---------------------------------------------------------------------------
 * This file is autogenerated file using gcdb parser. Please do not edit it.
 * Update input XML file to add a new entry or update variable in this file
 * VERSION = "1.0"
 *---------------------------------------------------------------------------*/
&mdss_mdp {
	dsi_jdi_lpm068a253a_1080p_60_cmd: qcom,mdss_dsi_jdi_lpm068a253a_1080p_60_cmd {
		qcom,mdss-dsi-panel-name = "jdi lpm068a253a 1080p 60 command mode dsi panel";
		qcom,mdss-dsi-panel-controller = <&mdss_dsi0>;
		qcom,mdss-dsi-panel-type = "dsi_cmd_mode";
		qcom,mdss-dsi-panel-destination = "display_1";
		qcom,mdss-dsi-panel-framerate = <60>;
		qcom,mdss-dsi-virtual-channel-id = <0>;
		qcom,mdss-dsi-stream = <0>;
		qcom,mdss-pan-physical-width-dimension = <84>;
		qcom,mdss-pan-physical-height-dimension = <150>;
		qcom,mdss-dsi-panel-width = <1080>;
		qcom,mdss-dsi-panel-height = <1920>;
		qcom,mdss-dsi-h-front-porch = <100>;
		qcom,mdss-dsi-h-back-porch = <80>;
		qcom,mdss-dsi-h-pulse-width = <20>;
		qcom,mdss-dsi-h-sync-skew = <0>;
		qcom,mdss-dsi-v-back-porch = <9>;
		qcom,mdss-dsi-v-front-porch = <8>;
		qcom,mdss-dsi-v-pulse-width = <1>;
		qcom,mdss-dsi-h-left-border = <0>;
		qcom,mdss-dsi-h-right-border = <0>;
		qcom,mdss-dsi-v-top-border = <0>;
		qcom,mdss-dsi-v-bottom-border = <0>;
		qcom,mdss-dsi-bpp = <24>;
		qcom,mdss-dsi-color-order = "rgb_swap_rgb";
		qcom,mdss-dsi-underflow-color = <0xff>;
		qcom,mdss-dsi-border-color = <0>;
		qcom,mdss-dsi-pixel-packing = "tight";
		qcom,mdss-dsi-pixel-alignment = <0>;
		qcom,mdss-dsi-on-command-state = "dsi_lp_mode";
		qcom,mdss-dsi-off-command-state = "dsi_lp_mode";
		qcom,mdss-dsi-lane-map = "lane_map_0123";
		qcom,mdss-dsi-lane-0-state;
		qcom,mdss-dsi-lane-1-state;
		qcom,mdss-dsi-lane-2-state;
		qcom,mdss-dsi-lane-3-state;
		qcom,mdss-dsi-te-pin-select = <1>;
		qcom,mdss-dsi-te-v-sync-rd-ptr-irq-line = <0x2c>;
		qcom,mdss-dsi-te-dcs-command = <1>;
		qcom,mdss-dsi-te-check-enable;
		qcom,mdss-dsi-te-using-te-pin;
		qcom,mdss-dsi-panel-timings = [CA 36 24 00 66 68 28 38 2A 03 04 00];
		qcom,mdss-dsi-t-clk-post = <0x02>;
		qcom,mdss-dsi-t-clk-pre = <0x2a>;
		qcom,mdss-dsi-bl-min-level = <80>;
		qcom,mdss-dsi-bl-max-level = <4095>;
		qcom,mdss-dsi-dma-trigger = "trigger_sw";
		qcom,mdss-dsi-mdp-trigger = "none";
		qcom,mdss-dsi-bl-pmic-control-type = "bl_ctrl_wled";
		qcom,mdss-dsi-reset-sequence = <1 10>, <0 1>, <1 20>;

		/* iris setting*/
		/* iris mipi mode */
		qcom,iris-mipirx-channel = <0x1>;    /*dual channel*/
		qcom,iris-mipitx-channel = <0x1>;
		qcom,iris-mipirx-dsc = <0x0>;        /*non DSC*/
		qcom,iris-mipitx-dsc = <0x0>;
		qcom,iris-mipirx-pxl-mode = <0x0>;
		qcom,iris-mipitx-pxl-mode = <0x1>;
		/* the mipitx of iris will always works at video mode.
		so the panel should be configured as video mode */
		/* need to review*/
		qcom,mdss-dsi-on-command-to-video-panel = [
			15 01 00 00 00 00 02 FF 10
			15 01 00 00 00 00 02 FB 01
			15 01 00 00 00 00 02 BB 13
			05 01 00 00 78 00 02 11 00
			15 01 00 00 00 00 02 BB 13
			15 01 00 00 00 00 02 3B 03
			15 01 00 00 00 00 02 3B 02
			15 01 00 00 00 00 02 3B 08
			15 01 00 00 00 00 02 3B 64
			15 01 00 00 00 00 02 3B 64
			05 01 00 00 00 00 02 29 00
		];
		qcom,mdss-dsi-on-command-to-video-panel-state = "dsi_lp_mode";
		/* need to review*/
		qcom,mdss-dsi-off-command-to-video-panel = [
			05 01 00 00 00 00 02 28 00
			05 01 00 00 3C 00 02 10 00
		];
		qcom,mdss-dsi-off-command-to-video-panel-state = "dsi_hs_mode";
		/* configure mipirx of iris to support command mode */
		/* need to review*/
		qcom,mdss-dsi-on-command-to-iris-mipirx = [
			15 01 00 00 01 00 02 3a 77 /* rgb_888 */
			15 01 00 00 01 00 02 35 00 /* set tearing on */
			39 01 00 00 01 00 05 2a 00 00 04 37
			39 01 00 00 01 00 05 2b 00 00 07 7f
		];
		qcom,mdss-dsi-on-command-to-iris-mipirx-state = "dsi_hs_mode";

		/*iris out timing*/
		qcom,iris-out-panel-width = <1080>;
		qcom,iris-out-panel-height = <1928>;
		qcom,iris-out-h-front-porch = <100>;
		qcom,iris-out-h-back-porch = <80>;
		qcom,iris-out-h-pulse-width = <20>;
		qcom,iris-out-v-back-porch = <1>;
		qcom,iris-out-v-front-porch = <8>;
		qcom,iris-out-v-pulse-width = <1>;

		/* iris sys */
		qcom,iris-dpll-clk = <148838400>;
		qcom,iris-dpll0 = <0xA>;
		qcom,iris-dpll1 = <0x2E1A01>;
		qcom,iris-dpll2 = <0x831250>;

		/* iris mipi rx */
		qcom,mipirx-dsi-functional-program = <0x64>;
		qcom,mipirx-data-lane-timing-param = <0xFF08>;

		/* iris mipi tx */
		qcom,mipitx-dsi-functional-program = <0x6204>;
		/* panel ddr clk 499.2M */
		qcom,mipitx-phy-pll-ratio = <26>;
		qcom,mipitx-phy-byteclk = <124800000>;
		qcom,mipitx-hs-transmit-timeout = <0x752FFF>;
		qcom,mipitx-lp-receive-timeout = <0x26>;
		qcom,mipitx-hs-lp-switching-time-count = <0x2E>;
		qcom,mipitx-pll-lock-count = <0x780>;
		qcom,mipitx-clock-lane-switching-time-count = <0x42001F>;
		qcom,mipitx-lp-equivalent-byteclk = <0x7>;
		qcom,mipitx-dphy-param = <0x130a1202>;
		qcom,mipitx-data-lane-timing-param = <0xd072503>;

		qcom,iris-delta-period-max = <10>;
		qcom,iris-delta-period-min = <4>;

	};
};
