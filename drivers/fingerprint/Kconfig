## drivers/fingerprint/Kconfig
```kconfig
menuconfig FINGERPRINT
	bool "Fingerprint support"
	help
	  Say Y here to enable fingerprint class support. 

config SYNA_FINGERPRINT_SPI
	tristate "Synaptics fingerprint driver"
	help
	  This enables the support for synaptics fingerprint driver.
```
