
qcom,2348791_asus_mercury_4600mah_averaged_masterslave_mar11th2016 {
	/* #2348791_Asus_Mercury_4600mAh_averaged_MasterSlave_Mar11th2016*/
	qcom,max-voltage-uv = <4400000>;
	qcom,nom-batt-capacity-mah = <4600>;
	qcom,batt-id-kohm = <51>;
	qcom,battery-beta = <3435>;
	qcom,battery-type = "asus_mercury_4600mah_mar11th2016";
	qcom,chg-rslow-comp-c1 = <4358036>;
	qcom,chg-rslow-comp-c2 = <8747588>;
	qcom,chg-rs-to-rslow = <754243>;
	qcom,chg-rslow-comp-thr = <0xC0>;
	qcom,checksum = <0x24D7>;
	qcom,gui-version = "PMI8950GUI - 2.0.0.15";
	qcom,fg-profile-data = [
		 DF 83 B2 7C 
		 E5 80 D2 76 
		 69 83 75 75 
		 20 8A 10 95 
		 23 82 31 9A 
		 2D BD C6 C9 
		 56 11 E9 83 
		 8F 7C A2 80 
		 17 76 5E 83 
		 E1 39 A0 82 
		 CA 8E 4F 82 
		 CF 99 34 BD 
		 47 CA 54 0E 
		 ED 11 BE 59 
		 14 70 E1 FA 
		 2E 3C 15 44 
		 FE 32 00 00 
		 B2 46 6D 07 
		 43 40 00 00 
		 00 00 00 00 
		 00 00 00 00 
		 BF 69 07 69 
		 B9 69 18 88 
		 D8 75 F8 68 
		 03 69 A4 82 
		 D5 74 F9 62 
		 12 5A 63 A1 
		 15 23 60 37 
		 5D A0 71 0C 
		 28 00 FF 36 
		 F0 11 30 03 
		 00 00 00 0C 
	];
};
